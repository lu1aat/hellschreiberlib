#include "Arduino.h"
#include "Hell.h"

Hell::Hell(int pin) {
    pinMode(pin, OUTPUT);
    _pin = pin;
}

//
// Symbol table
//
// A-Z group is ASCII 65-90 located from 0 to 25
// 0-9 group is ASCII 48-57 located from 25 to 35
// Special charaters from 36
//
// This python line helps to build each column `hex(int("0010000", 2))`
//
int hellSymbols[][7] = {
    {0x3E, 0x28, 0x28, 0x28, 0x3E},       // 0  A
    {0x7C, 0x54, 0x54, 0x54, 0x28},       // 1  B
    {0x3E, 0x22, 0x22, 0x22, 0x00},       // 2  C
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    {0x00, 0x28, 0x10, 0x28, 0x00}     // 41 *
};

// Tone
void Hell::tone() {
    digitalWrite(_pin, HIGH);
    delayMicroseconds(_toneDurationMicrosconds);
}

// Transmite mensaje
void Hell::tx(char message[]) {
  // Iter over message characters
  for(byte i = 0; i < strlen(message); i++) {
    _charCurrent = message[i];
    // Check for SPACE, DEC 32
    if(_charCurrent == 32) {
      delay(_wordSpacingMs);
      continue;
    }

    // Calculate character position in symbol table
    int symbolIndex = 0;
    int symbolShift = 65;

    // Special characters will need to be shifted, this code can be improved/refactored
    if(_charCurrent == 46) {  // 46 is dot "."
        symbolShift = 10;
    } else if (_charCurrent == 45) {  // 45 is dash "-"
        symbolShift = 8;
    } else if (_charCurrent == 61) {  // 61 is dash "="
        symbolShift = 23;
    } else if (_charCurrent == 58) {  // 58 is ":"
        symbolShift = 19;
    } else if (_charCurrent == 33) {  // 33 is "!"
        symbolShift = -7;
    } else if (_charCurrent == 42) {  // 42 is "*"
        symbolShift = 1;
    } else if (_charCurrent < 58) {
        symbolShift = 22;
    }
    symbolIndex = _charCurrent - symbolShift;

    // Get symbols for this character, send signals by setting _pin into HIGH in the required intervals
    for(byte ii = 0; ii < _columns; ii++) {
      int column = 0;
      column = hellSymbols[symbolIndex][ii];

      // Iter over pixels
      int pix;
      for (pix = 1; pix <= 7; pix++) {
         if(bitRead(column, pix) == 1) {
            tone(); 
         } else {
            digitalWrite(_pin, LOW);
            delayMicroseconds(_toneDurationMicrosconds);
         }
      }

    }

    // Delay between each character
    delay(_charDelay);
  }
}